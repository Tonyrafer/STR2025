## P2-2/src/Kconfig.projbuild
```kconfig
menu "Matrix Configuration"
    config MATRIX_SIZE
        int "Size of the square matrix"
        range 1 10000
        default 10
        help
            Set the size of the matrix for multiplication (N x N)
endmenu
```
